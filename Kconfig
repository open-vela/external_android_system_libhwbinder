## Kconfig
```kconfig
#
# Copyright (C) 2023 Xiaomi Corporation
#
# Licensed under the Apache License, Version 2.0 (the "License");
# you may not use this file except in compliance with the License.
# You may obtain a copy of the License at
#
#      http://www.apache.org/licenses/LICENSE-2.0
#
# Unless required by applicable law or agreed to in writing, software
# distributed under the License is distributed on an "AS IS" BASIS,
# WITHOUT WARRANTIES OR CONDITIONS OF ANY KIND, either express or implied.
# See the License for the specific language governing permissions and
# limitations under the License.
#

config ANDROID_LIBHWBINDER
	tristate "Libhwbinder"
	depends on LIBCXX && KVDB

config BINDER_PERFORMANCE_TEST
	tristate "Binder performance test"
	depends on ANDROID_LIBHWBINDER

config BINDER_PERFORMANCE_STACKSIZE
	int "Binder performance Stacksize"
	depends on BINDER_PERFORMANCE_TEST
	default DEFAULT_TASK_STACKSIZE
```
